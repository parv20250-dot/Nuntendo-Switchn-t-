/*This code is for the Nintendo Switchn't a handheld gaming console that has been
build and designed by me.

The firmware contains three (maybe four) different games:-
1)Snake
2)Pong
3)Tetris
4) Maybe and this is a big maybe like a big huge maybe an endless runner
I will try to make them color coded as much as possible for uhhh aesthethics,
lets see how that goes*/

#include <Arduino.h>
#include <SPI.h>
#include <EEPROM.h>
#include <Adafruit_GFX.h>
#include <Adafruit_ST7789.h>
#include <DFRobotDFPlayerMini.h>
#include <runner.h

const int TFT_SCLPIN = 18;
const int TFT_SDAPIN = 19;
const int TFT_CSPIN = -1;
const int TFT_DCPIN=16;
const int TFT_RESPIN = 20;
const int TFT_BLKPIN=21;  //Pin numbers
const int BUZZER_PIN = 22;
const int  BATTERY_PIN = 26;
const int DF_INPUT = 0;
const int DF_output =1;

#define TFT_MODE SPI_MODE0 
#define BACKLIGHT_ACTIVE 1 
#define BUZZER_ACTIVE 0
const float BATTERY_CALIBRATION = 1.0;//NO CALIBRATION NOW, NORMAL READING
const int Screen_Width =240: //width of display in pixels
const int SCREEN_Height = 240; //height of display in pixels 
enum Button {Button_up, Button_down, Button_left, Button_right
    Button_A,Button_b, Button_X, Button_Y, Button_Select,Button_back, Button_COUNT};
     //creates buttons and gives them names
    //defines the pins of buttons acc to schematic
const int BUTTON_PINS[BUTTON_NO]={3,4,5,6,7,8,9,10,11,12}

constexpr uint16_t rgb (uint8_t r, uint8_t g, uint8_t b){ //expression
  int R = (r& 0xF8)<<8; int G = (g & 0xFC)<<3; int B =b >>3;
  return R|G|B;} //8 bit RGB to 16 bit,combines them together into single 16 bit

const uint16_t BLACK = rgb(0,0,0);
const uint16_t WHITE = rgb(255,255,255);
const uint16_t purple = rgb(44, 4, 96);
const uint16_t Lessdark_purple = rgb(110, 48, 242);
const uint16_t color_text = rgb(211, 204, 243); //idk if I mentioned this but the console has a purple theme cuz why not
const uint16_t subtext = rgb(194, 160, 238);
const uint16_t RED = rgb(210, 75, 63);
const uint16_t green = rgb(81, 228, 135)
const uint16_t yellow = rgb(253,198,101);
const uint16_t snake_accent = rgb(167,139,250); //each game will have a color, snake = purple
const uint16_t tetris_accent = rgb(114, 164, 246); //tetris = blue
const uint16_t pong_accent = rgb(244, 114, 182); //pong = pink
const uint16_t runner_accent = rgb(125, 237, 134); // runner = green(?) might change when i code it
#define dimcolor(c)((uint16_t)(((c)&0xF7DE)>>1)) //makes a dimmer version of color

enum GAMESSSSS {SNAKE, TETRIS, PONG, RUNNER, GAME_COUNT} //games

enum Screen {screen_menu, screen_infor, screen_countdown, screen_playing
              screen_gameover, screen_settings}; ///stuff that is shown onn the screen
              //diff stuff that can be shown on the screen

struct Note {uint16_t frequency; uint16_t ms;};

const uint8_t BRIGHTNESS_PWM[6]= {0,30,80,140,200,25};  //brightness levels

void backlightset (uint8_t level){
  if (level > 5) level =5;
  uint8_t duty = BRIGHTNESS_PWM[level];
  #if BACKLIGHT_ACTIVE 
  duty = 255- duty;
  #end if 
  analogWrite(TFT_BLKPIN,duty);}

void display_begin (){
  pinMode(TFT_BLKPIN, OUTPUT);
  analogWriteFeq(20000); //fast to ensure no flickering
  backlightset(0); //stays dark
  SPI.setSCK(TFT_SCLPIN);
  SPI.setTX(TFT_SDAPIN);
  SPI.setRX(-1); //no output from screen, just visual display
  tft.init(Screen_Width, Screen_Height, TFT_MODE)
  tft.setSPISpeed(40000000); //40MHz
  tft.SetRotation(0); //no rotation on images
  #if tft_invert
  tft.invertDisplay(true); 
  #endif 
  pinMode(TFT_DCPIN,OUTPUT);
  tft.fillScreen(purple);} //sets purple background

void draw_text_at (int x, int y, const char * text, uint8_t size,
  uint16_t color){
    tft.setTextSize(size):
    tft.setTextColor(color);
    tft.setCursor(x,y);
    tft.print(text);}
   

void draw_text_center(int center X, int y, const char * text, 
  uint8_t size, uint16_t color){
 int width= strlen(text)*6*size //finds width in pixels
    draw_text_at(centerX- width/2,y, text, size, color);} //cenetrs text

void drawTextBg (int x, int y, const char *text, uint8_t size,
   uint16_t color, uint 16_t bg){
    tft.setTextSize(size);
    tft.setTextColor(color,bg);
    tft.setCursor(x,y);
    tft.print(text);}

void drawBatteryicon (int x. int y, int percent, bool present){
  tft.fillRect(x-1,y-1.28,14,purple); //draws a rectangle
  tft.drawRect(x,y,27,12,Lessdark_purple); //draws outline
  tft.fillRect(x+27, y+3,2,6,Lessdark_purple); //makes rectangle battery icon,, adds smol rectangle
  if(!present){drawTextAt(x+6, y+2,"USB",1,Lessdark_purple);
    return;}
  int bars = (percent + 10)/20; //no of bars outta 5
  if(bars >5) bars =5;
  uint 16_t color;
  if (percent> 25){
    color = green;} //full battery = green 
  else{color = RED;} //low battery = red
  for (int i = 0; i<bars; i++){
    tft.fillRect(x+2+i*4,y+2,3,8,color);}} //fills bars according to battery level

const uint16_t muteIcon [18*18] = {
  0x0000, 0x282C, 0x282C, 0x282C, 0x282C, 0x282C, 0x282C, 0x282C, 0x282C, 0x282C, 0x282C, 0x282C,
  0x282C, 0x282C, 0x282C, 0x282C, 0x282C, 0x282C, 0x282C, 0x0000, 0x282C, 0x282C, 0x282C, 0x282C,
  0x282C, 0x282C, 0x282C, 0x282C, 0x282C, 0x282C, 0x282C, 0x282C, 0x282C, 0x282C, 0x282C, 0x282C,
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  0x282C, 0x282C, 0x282C, 0x282C, 0x282C, 0x282C, 0x282C, 0x282C, 0x282C, 0x282C, 0x282C, 0x0000
};

const uint16_t soundIcon [18*18] = { 0x5096, 0x5075, 0x5075, 0x5075, 0x5075, 0x5075, 0x5055, 0x5055, 0x5056, 0x5036, 0x5036, 0x5056,
  0x5036, 0x5056, 0x5056, 0x5056, 0x5075, 0x5076, 0x5095, 0x5075, 0x5075, 0x5075, 0x5075, 0x5075,
  0x5075, 0x5055, 0x5055, 0x5055, 0x5056, 0x5056, 0x5056, 0x5055, 0x5055, 0x5055, 0x5075, 0x5075,
  0x5075, 0x5075, 0x5075, 0x5075, 0x5075, 0x5075, 0x5075, 0x5075, 0x2166, 0x5055, 0x5055, 0x5055,
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  0x5095, 0x5075, 0x5075, 0x5075, 0x5075, 0x5075, 0x5075, 0x5075, 0x5075, 0x5075, 0x5095, 0x5076
};
//end of display
//________________________________________________________________________
//start of battery stuff
float batteryVolts = 0;
int batteryPercent = 0;
bool batteryPresent = false; //false by default, can be run by usb, true if battery
uint32_t batteryNextRead = 0;

void batteryread(){
  analogReadResolution(12);
  long sum = 0;
  for(int i=0; i<16;i++){ //finds sum of 16 readings
    sum +=analogRead(BATTERY_PIN);
    delayMicroseconds(200);}
  float avg = sum/16.0f //takes their average
  batteryVolts = avg/ 4095.0f * 3.3f*2.0f* BATTERY_CALIBRATION //converts to voltage 
  batteryPresent =(batteryVolts > 2.5f);
  int pct = (batteryVolts-3.3f)/(4.2f-3.3f)*100.0f;//4.2 max and 3.3 min
  if (pct<0)pct = 0;
  if (pct >100)pct = 100;
  batteryPercent = pct;}

void batteryUpdate(){
  if(millis()>= batteryNextRead){
    batteryNextRead =millis() + 5000;
    batteryRead();}}
//END OF BATTERY STUFF
//__________________________________________________________________________
//Start of Buttons
const uint32_t debounce_MS = 15; //no fickering readings, 15 ms bw readigs
bool buttonheld[Button_COUNT]; //pressed
bool buttonpressed[Button_COUNT];//new press or nay
uint32_t buttonlastchange [Button_COUNT];//last change state when?

void inputBegin (){
  for(int i = 0; i< Button_COUNT; i++){
    pinMode(BUTTON_PINS[i], INPUT_PULLUP);
    buttonheld[i]= false;
    buttonpressed[i] = false;
    buttonlastchange[i]= 0;}} //sets everything to default values at start

void inputupdate(){
  uint32_t now = millis();
  for (int i=0;i < Button_COUNT, i++){
    buttonpressed[i]= false; //resets before checking/getting input
    bool down = digitalRead(BUTTON_PINS[i])== LOW;
   if (down != buttonheld[i] && now- buttonlastchange[i] >= debounceMS){
    buttonheld[i]= down;//updates all if down
    buttonLastChange[i]= now; 
  if (down) buttonpressed[i]= true; //updates all if down

  bool held (Button b){return buttonheld[b];}
  bool pressed(Button B){return buttonpressed[b];} //which button was just held or pressed
//end of buttons
//________________________________________________________________________________
//start of save high scores 
const uint32_t save_signature = 0x4844E44;
struct Savedata {uint32_t signature; uint32_t highscore[GAME_COUNT]};uint8_t brightness;
uint8_t musicon; uint8_t sfxon};
Savedata save;
void saveWrite(){
  EPROM.put(0,save);
  EPROM.commit();} //saves data

void saveReset(){
  save.signature = save_signature;
  for (int i = 0; i< GAME_COUNT;i++){
    save.highscore[i]=0;} //loop saves high score for all games with identification signature
    save.brightness =4;
    save.musicon = 1;
    save.sfxOn = 1;}
  
void storageBegin(){
  EPROM.begin(256);
  EPROM.get(0,save) //gets and reads saved data
  if (save.signature != save_sognature){
    saveReset();
    saveWrite();} //if identification nos dont match it rests and uses default setiingsd
  if (save.brightness <1 or save.brightness >5)
  save.brightness = 4;}
//end of saving high scores
//___________________________________________________________________________
//start of sound
//DF player
DFRobotDFPlayerMini player;
bool playeryes = false; //DF player did not answer its false
bool musicmuted = false; //the X botton, mutes soundtrack
int currenttrack =1; //currently selected sountrack, each game has diif track

void musicstart(){
  if (!playeryes or musicmuted or !save.musicon)
  //returns if player did not answer, music muted, no saved music
  return;
  player.volume(20); //sets volume at 20
  player.playMp3Folder(currenttrack); //plays current track
  player.enableLoop();} //loops track

void musicStop(){
  if(!playeryes)return;
  player.stop();}     //checks if its working if it is stops current track

void  musicchange(int track){
  if(currenttrack== track)
  return;
  currenttrack =track;
  musicstart();} //if new track is same then return else plays new track

void musicapply(){
  if (save.musicon && !musicmuted){
    musicstart();}
  else{musicStop();}} //if music is on and not muted it plays else it stops

//Buzzer
const Note SFX_YAYY[]={
  {1760,70},{2093,70},{2637,140}} //rising note (sumn good happens)
const Note SFX_WOMP[]={
  {600,140},{420,140},{300,280}};//falling note (sumn bad happens)
const Note SFX_TICK[]={{2000,60}};
const Note SFX_GO []={{2600,220}};
//notes 

const Note*sfxlist = nullptr; //beep rn
int sfxlength = 0 //length default value
int sfxindex = 0; //which note 
uint32_t sfxend = 0; //when the note should end
bool sfxplaying = false; //default value tru when playing

void buzzeridle(){
  notone(BUZZER_PIN);pinMode(BUZZER_PIN,OUTPUT);
  #if BUZZER_ACTIVE
  digitalWrite(BUZZER_PIN,HIGH);
  #endif
} //puts Buzzer on high (passive state)

void sfxstartnote(){
  tone(BUZZER_PIN, sfxlist[sfxindex].frequency);
  sfxend = millis() + sfxlist[sfxindex].ms;} //starts the current note, its duration

void sfxplay(const Note *list, int length){
  if (!save.sfxon) return; //if nothing saved return
  sfxlist = list 
  sfxlength = length
  sfxindex = 0;
  sfxplaying = true; //sets the details for the specific note then calls start note
  //so that that note is played
  sfxstartnote();}

void soundUpdate(){ //updates sound being played
  if (!sfxplaying) return; //if no sound being played then exits
  if (millis()>= sfxend){sfxindex++; 
      if (sfxindex >= sfxlength){
        sfxplaying = false;
        buzzer idle();} //stops playing makes buzzer idle
      else{sfxstartnote();}}} //starts next note

void sfxyay(){sfxplay(SFX_YAYY,sizeof(SFX_YAYY)/sizeof(SFX_YAYY[0]));} 
  //calls rising tune (good)
void sfxwomp(){sfxplay(SFX_WOMP,sizeof(SFX_WOMP)/sizeof(SFX_WOMP[0]));}
//calls falling tune (bad)
void sfxtick(){sfxplay(SFX_TICK,sizeof(SFX_TICK)/sizeof(SFX_TICK[0]));}
//calls the tick sound
void sfxgo(){sfxplay(SFX_GO,sizeof(SFX_GO)/sizeof(SFX_GO[0]));}
//calls teh go sound

void Mutesound(){
  musicmuted = !musicmuted;
  if (musicmuted){musicStop();}
  else{musicstart();}} //mute settings, if music muted it stops music, else plays

void soundbegin(){
  buzzeridle(); 
  Serial1.begin(9600); //Serial connection, at 9600 baud
  playeryes = player.begin(Serial1,true,false); //checks if player is okay, enables debugging
  musicapply();}
// end of sounds
//______________________________________________________________________
//start of games

bool gameWon = false //(Player has not won)
constint header_height =24; //header to 24 pixels
void drawscoreheader (uint32_t score, uint32_t best, uint16_t accent){
  char score_text[24];
  snprintf(score_text, sizeof(score_text), "SCORE%lu",(unsigned long)score);
  //score stored as score text, lu is a placeholder, unsigned long coverts to lu format
  drawTextBg(6,4,score_text,2, accent, purple) //shows text using draw text function
  snprintf(score_text,sizeof(score_text), "BEST%lu",(unsigned long)best);
  int width =strlen(score_text)*12; //diff widths so multiplies no of characters by 12 pixels
  drawTextBg(Screen_Width-width -6,4,score_text,2,subtext,purple)}
  //draws best score, finds position such that its 6 pixels away from right
  //its subtext color (lighter purple) and bg is purple

//start of snake

const int snake_cell = 12
const int snake_columns = 20
const int snake_rows = 18; //grid = 20x18
const int snake_top = header_height;  //starts only below header scores
const int snake_max = snake_columns *snake_rows//maximum  possible length of snake

struct Cell {int8_t x; int8_t y;}; //each cell (square) defined by x, y coordiates

Cell snakebody[snake_max]; 
int snakelength; //current length of snake
int snakedirectionX, snakedirectionY; // x is left or right, y is up down, 
//snake direction
int snakenewdirectionX, snakenewdirectionY; //new directions by player
Cell snakefood; //food coordinates
uint32_t snakescore; //current score
uint32_t snakenextMS; //snake move next time
int snakedelayMS; //controls snake speed (faster at higher scores)
const uint16_t snakehead_color = rgb(154, 129, 253); //snake head color 
//easy to know direction of movement
const uint16_t snakebody_color = snake_accent //snake body color
const uint16_t snakeoutline_color = rgb(93, 61, 145); //outline of snake
const uint16_t snakefood_color = RED
void snakedrawcell(int cx, int cy,uint16_t color){
  int x = cx* snake_cell;
  int y = snake_top+cy * snake_cell (); //grid to pixels, each grid is 12 pixels
  //y starts only after header so that'd added
  tft.fillRect(x,y,snake_cell,snake_cell,snakeoutline_color); //large square total
  tft.fillRect(x+1,y+1,snake_cell-2,snake_cell-2,color);}
  //draws a smaller colored square inside large square

void snakedrawHead(int cx, int cy){
  snakedrawcell(cx, cy, snakehead_color);
  int x = cx* snake_cell;
  int y = snake_top+cy * snake_cell(); //grid to pixels
  //y starts only after header so that'd added
  //eyes of radius 1.5 pixels
  if(snakedirectionX ==1){
    tft.fillCircle(x+8,y+4,1,purple);
    tft.fillCircle(x+8,y+8,1,purple);} //going right, draws eyes
  else if (snakedirectionX == -1){
    tft.fillCircle (x+4,y+4,1,purple);
    tft.fillCircle(x+4,y+8,1,purple);} //going left,draws eyes
  else if (snakeDirY = -1){
    tft.fillCircle(x+4,y+4,1,purple);
    tft.fillCircle(x+8,y+4,1,purple);} //going up, draws eyes
  else {tft.fillCircle(x+4,y+8,1,purple);
    tft.fillCircle(x+8,y+8,1,purple)}} //going down, draws eyes

void drawfood(){
  int x = snakefood.x*snake_cell+snake_cell/2;
  int y = snake_top+snakefood.y*snake_cell+snake_cell/2; 
  // find center of cell
  tft.fillCircle(x,y,4,snakefood_color);}//draws food in red in cell, redius 4

void snakeerasecell(int cx, int cy){
  tft.fillRect(cx*snake_cell,snake_top+cy* snake_cell, snake_cell,purple);}
  //erases a cell by filling it with bg color

void drawsnakescore(){
  drawscoreheader(snakescore,save.highscore[SNAKE], snake_accent);}
//draws score/high score on header

void snakeredraw(){
  tft.fillScreen(purple); //clears by filling screen with bg color
  tft.drawFastHLine(0,snake_top-1,Screen_Width,snake_accent)
  //draws a line under header then draws header and scores
  drawsnakescore();
  for(int i= snakelength-1;i >= 0;i--){ //draws body and head
    if (i==0){
      snakedrawHead(snakebody[i].x, snakebody[i].y);}
    else {snakedrawcell(snakebody[i].x,snakebody[i].y),snakebody_color;}}
    drawfood();} //draws the food

void placefood(){ //places food in a random unoccupied spot
  while (true){ //loop continues till unoccupied spot found
    int x = random(snake_columns);
    int y = random(snake_rows);
    bool onSnake = false; 
    for (int i=0;i<snakelength;i++){
      if(snakebody[i].x == x&& snakebody[i].y==y){
        onSnake = true;
        break;}} //stops then starts loop again to pick another cell
      if (!onSnake){ //if on snake stays false aka not on snake
        snakefood.x =x;
        snakefood.y =y;
        drawfood(); //draws the apple
        return;}}}

void snakeStart(){
  gameWon =false;
  snakescore = 0; //resets to start values
  snakelength =3;
  snakebody[0].x =10;
  snakebody[0].y = 9;
  snakebody[1].x =9;
  snakebody[1].y =9;
  snakebody[2].x = 8;
  snakebody[2].y = 9;
  snakedirectionX= 1;
  snakedirectionY = 0; //turned right
  snakenewdirectionX = 1;
  snakedirectionY = 0; //moves to right when it starts off
  snakedelayMS = 150;
  snakenextMS = millis() + 400
  snakeredraw();
  placefood();}

bool snakeUpdate(){ //true while running,false when ends
  if (pressed(Button_up)&& snakedirectionY==0){ //on pressing up button and not already moving verticaally
    snakenewdirectionX = 0; snakenewdirectionY =-1;} 
  if (pressed(Button_down)&& snakedirectionY == 0){ //turns down,if snake not moving vertically
    snakenewdirectionX= 0; snakenewdirectionY = 1;}
  if (pressed(Button_left)&& snakedirectionX ==0){//turns left, if not moving hotizontally
    snakenewdirectionX =-1;snakenewdirectionY =0;}
  if (pressed(Button_right)&&snakedirectionX ==0){//turns right if not moving vertically
    snakenewdirectionX = 1; snakenewdirectionY =0;}
  
  if((int32_t)(millis()-snakenextMS)<0){
    return true;} //wait if not time for next move
    snakenextMS= millis()+ snakedelayMS;//next move
    snakedirectionX = snakenewdirectionX;
    snakedirectionY = snakenewdirectionY; //apply direction user inputs
  
  Cell newHead;
  newHead.x = snakebody[0].x + snakedirectionX;
  newHead.y =snakebody[0].y+snakedirectionY; //finds where new head should be

  if (newHead.x<0 or newHead.x >= snake_columns or newHead.y <0 or newHead.y >=
  snake_rows){ //checks for wall collision if new head is outside grid it has 
    //crossed wall ie game ends
    sfxwomp(); // sad beeps play
    return false;} 
  
  bool ate =(newHead.x == snakefood.x && newHead.y == snakefood.y)
  //if new head is where snake food is snake has eaten

  for (int i = 0; i < snakelength; i++){ //checks for self collision
    if (!ate  && i == snakelength-1){ //if not eating ignore, it moves, no get bigger
      continue;}
    if (snakebody[i].x == NewHead.x && snakebody[i].y == newHead.y){
      sfxwomp();
      return false;}} //if new head collides with ANY of snake's body, game ends
  
  Cell oldTail =snakebody[snakelength-1]; //remember old atil
  if (ate){
    snakelength++;} //if ate length increases
  else{
    snakeerasecell(oldTail.x,oldTail.y);} //clears old tail
  for (int i = snakelength-1;i > 0; i--){
    snakebody[i]=snakebody[i-1];}
    snakebody[0]=newHead; //moves the snake cells one by one,new head at beginning

  snakedrawcell(snakebody[1].x, snakebody[1].y,snakebody_color);
  //draws new body,1 as head draw differently, x,y cooordinates
  snakedrawHead(newHead.x,newHead.y);
  //draws new head aka snakebody[0]
  if (ate){
    snakescore++; //increases scores
    sfxyay(); //plays yay sound effect,rising note
    snakedelayMS = 150-(int)snakecore*3 //as score increases delay decreases
    //speed increases ny 3ms
    if (snakedelayMS<70){snakedelayMS==70;} //prevents it from getting too fast
    drawsnakescore(); 
    if(snakelength>= snake_max){
      gameWon=true; //if snake fills entire board, player wins
      sfxtick(); //plays sound
      return false;} //ends game loop
    placefood();} //places another apple
    return true;} //continues loop
//END OF SNAKE YAY
//______________________________________________________________________________
//PONG (10points win, more then high score, single player)
const int pongtop = header_height;
const int pongpaddle_width = 6;
const int pongpaddle_height = 40;
const int pongball = 6;
const int pongleftx = 8; //starts at 8 units from left
const int pongrightx = Screen_Width-8-pongpaddle_width; //ends at 8 units from right
//starts at 8 units from right+ width of paddle
const int pongwin = 10; //10 points to win
const int pongframeMS= 16; 
int pongplayery, pongcompy; //y coordinates of the pong paddles (x ones above)
int pongballx, pongbally; //x,y coordinates of ball
int pongvx,pong vy; //horizontal and vertical velocity of ball
int pongplayerscore,pongcompscore; //player and computer score 
uint 32_t pongscore;
int pongcompaim=0; //aiming mistake by compuetr
uint32_t pongnextframe=0; //next frame when
uint32_t pongserveat=0; //when ball starts moving
bool pongserving=false; //serving or not

void pongDrawBall(uint16_t color){ //draws ball in chosen color
  int x0 = pongballx 
  int x1 = pongballx+pongball //start and end of pong ball
  if (x0<0){x0 = 0;} //pong ball's end cant go outside siplay
  if (x1>Screen_Width){x1 = Screen_Width;} //same as above
  if (x1>x0) {tft.fillRoundRect (x0,pongbally,x1-x0,pongball,2,color);}}
  //draws a ball if its visible

void pongdrawceterline(){ //draws line in center
  for(int y= pongtop;y<Screen_Height; y+=12){ //gap in bw lines to make it dotted
    tft.fillRect(Screen_Width/2-1,y,6,subtext);}}

void pongdrawscore(){
  char pong_scores[16]; //16 bit array of scores
  snprint(text,sizeof(text),"%d",pongplayerscore); //draws player score
  drawTextBg(Screen_Width/2-40,4,text,2,pong_accent,purple);//text bg
  snprint(text,sizeof(text),"%d",pongcompscore);//shows computer score
  drawTextBg(Screen_Width/2+28,4,text,2,color_text,purple);}//text bg

void pongRedraw(){
  tft.fillScreen(purple); //everything erased in bg color now
  tft.drawFastHLine(0,pongtop-1,Screen_Width,pong_accent); //horizontal line at header
  tft.fillRect(pongleftx,pongplayery,pongpaddle_width,
    pongpaddle_height,pong_accent); //draws player paddle (left)
  tft.fillRect(pongrightx,pongcompy,pongpaddle_width,pongpaddle_height,
  color_text); //draws computer paddle
  pongDrawBall(WHITE);} //draws ball

void pongresetball (int direction){ 
  pongballx=Screen_Width/2-pongball/2;pongbally=(pongtop + Screen_Height)/
  2-pongball/2 //centres balls, centres whole squaree
  pongvx=3*direction //horizontal speed of 3
  pongvy=random(-2,3); //different serve power
  pongcompaim= random (-14,15); //aim could be bad, else comp too good
  pongserving = true;
  pongserveat = millis() +800;}

void pongmovepaddle(int x, int oldY, int newY; uint16_t color){
  //moves paddle, moves vertically, x stays same
  if (oldY ==newY)return;
  if(newY>oldY){
    tft.fillRect(x,oldY,pongpaddle_width,newY-oldY, purple)};
    //if it moves down draws bg over old pong position
  else {tft.fillRect(x,newY+pongpaddle_height,pongpaddle_width,
  oldY-newY,purple)} //if it moves up draw bg over old positiion
  tft.fillRect(x,newY,pongpaddle_width,pongpaddle_height,color):}
  int pongpaddleonscreen(int y){
  //Keeps padle on screen, it it moves away brings it back onto screen
  if(y<pongtop){y=pongtop;} //can't go above pong top
  if (y>Screen_Height - pongpaddle_height) {
    y= Screen_Height-pongpaddle_height;} //can't go below screen height 
    return y;}//#NO PADDLES PHASING DISPLAYS

void pongstart(){
  gameWon=false;
  pongplayerscore=0;
  pongcompscore=0;
  pongscore =0; //returns everything to default values
  pongplayery = (pongtop+Screen_Height)/2-pongpaddle_width/2;
  pongcompy = pongplayery; //puts paddles exactly in centre of their sides
  pongresetball(1); //ball in centre tehn towards computer to start game
  pongnextframe = millis();
  pongRedraw();} //draws next game screen 
//scoring is called if ball leaves screen, player or computer is determined
  bool pongpoint(bool playerscored){
  pongDrawBall(purple); //erases the ball
  if (playerscored) {
    pongplayerscore++; //adds to players score
    sfxyay(); //plays sound
    if(pongplayerscore>pongscore){ //updates high score if current score is more
      pongscore = pongplayerscore;}
    if(pongplayerscore >= pongwin){
      gameWon = true;}}
    else{pongcompscore++; //if player does not score computer does
      sfxwomp();
      if(pongcompscore>=pongwin or gameWon) { //if its comps 10th point it wins
        pongdrawscore();
        return true;}}
    pongdrawscore(); //updatees score
    if (playerscored){
      pongresetball(1);} //if player scored serve towards computer
    else{pongresetball(-1)};//opp of above
  pongdrawceterline();
  pongDrawBall(WHITE);
  return false;} //game running

bool pongupdate(){ //true if game running,else false
  if((int32_t)(millis()-pongnextframe) <0){
    return true;} //if its time for next frame retruns true
  pongnextframe = millis()+ pongframeMS; //scehdules next frame

int oldplayery = pongplayery; //store old paddle Y
if (held(Button_up)){pongplayery -= 4;} //moves up
if (held(Button_down)){pongplayery += 4;}//moves down
pongplayery =pongpaddleonscreen(pongplayery); //keeps it on screen

int oldcompy = pongcompy;
int target; 
if (pongvx > 0 && pongballx > Screen_Width/3 ){
  target = pongbally +pongball/2-pongpaddle_height+ pongcompaim;}
//if ball is moving towards comp side and has travelled 1/3 rd of screen, 
//comp targets ball with random offset
else{target = pongtop+Screen_Height/2-pongpaddle_height/2;}
//moves to center otherwise
int diff = target- pongcompy //diff bw comp paddle and target
if (diff> 4){pongcompy +=3;}
if (diff <= -4){pongcompy-=3;} //moves up or down accordingly
pongcompy = pongpaddleonscreen(pongcompy); //keeps paddle on screen
pongmovepaddle(pongleftx,oldplayery,pongplayery,pong_accent);
pongmovepaddle(pongrightx,oldcompy,pongcompy,color_text) 
//draws player/comp paddles,erases old ones
if(pongserving){
  if ((int32_t)(millis()-pongserveat)>= 0){
    pongserving=false;} //waiting period over served
  return true;} //else not served
pongDrawBall(purple); //erases old position
pongballx+=pongvx; //new horizontal velocity
pongbally+=pongvy;//new vertical velocuty
if (pongbally <= pongtop){pongbally=pongtop; pongvy =-pongvy;}
//if it goes out of screen on top wall,bring it back in reverse velocity 
if(pongbally >=Screen_Height-pongball){pongbally= Screen_Height-pongball;
pongvy = -pongvy;}
if(pongvx<0 && pongballx <= pongleftx+pongpaddle_width
   &&pongballx+pongball >=pongleftx && pongbally+ pongball >=pongplayery
  && pongbally<=pongplayery+pongpaddle_height){//if ball is moving towards player
    //balls right edge on paddle,left edge not passed it, vertical ranges overlap
    pongballx = pongleftx+pongpaddle_width;//ball in front of paddle
    pongvx = -pongvx; //reverses direction
    pongvy = ((pongbally +pongball/2)-(pongplayery+pongpaddle_height/2))/7;
    pongvy += random(-1,2) //if it hits on top half goes up,else goes down,mid
    //vy = 0
    if (pongvx<6){pongvx++;}//increases speed
    sfxtick();}

if(pongvx > 0 && pongballx+pongball>=pongrightx &&
  pongballx<= pongrightx+pongpaddle_width && pongbally+pongball >=pongcompy &&
  pongbally <= pongcompy+pongpaddle_height){
    pongballx =pongrightx-pongball; //if its has hit paddle,puts it outside
    pongvx =-pongvx; //reverses direction
    pongvy = ((pongbally+pongball/2)-(pongcompy+pongpaddle_height/2))/7;
    pongvy += random(-1,2); 
    pongcompaim =random(-14,15);} //new random offset
if (pongvy > 5){pongvy =5;}
if (pongvy < -5){pongvy=-5;} //limits in between -5,5, no too fast
if (pongballx +pongball<0){
  if(pongpoint(false)){
    return false;}
  return true;} //if ball has left left side,comp scores, else player
if(pongpoint(true)){
  return false;}
  return true;} //if ball has left right side,player scores,true mean scored
pongdrawceterline();
tft.fillRect(pongleftx,pongplayery,pongpaddle_width,pongpaddle_height,pong_accent);
//redraws paddle
tft.fillRect(pongrightx,pongcompy,pongpaddle_width,pongpaddle_height,color_text);
pongDrawBall(WHITE);
return true;}
//end of pong
//________________________________________________________________________
//START OF TERIS
const int tetcolumns = 10;
const int tetrows = 20; //creates a 10x20 grid
const int tetcell = 11; //square size in pixels
const int tetstarthoriz =10; //board start on screen
const int tetstartvert = 10; //board end on screen
const int tetpanelx = 134; //score panel
// The 7 pieces, in the order. Four rotations each.
const uint16_t tetshapes[7][4] = {
  { 0x0F00, 0x2222, 0x00F0, 0x4444 }, // I
  { 0x44C0, 0x8E00, 0x6440, 0x0E20 }, // J
  { 0x4460, 0x0E80, 0xC440, 0x2E00 }, // L
  { 0xCC00, 0xCC00, 0xCC00, 0xCC00 }, // O
  { 0x06C0, 0x8C40, 0x6C00, 0x4620 }, // S
  { 0x0E40, 0x4C40, 0x4E00, 0x4640 }, // T
  { 0x0C60, 0x4C80, 0xC600, 0x2640 },};// Z
const uint16_t tet_colors[7]= {
  rgb(71, 210, 232), //I color
  rgb(70, 111, 201),//J color
  rgb(105, 77, 169), //L color
  rgb(125, 13, 95), //O color
  rgb(36, 117, 92), //S color
  rgb(180, 199, 39),//T color 
  rgb(215,140,175)};//Z color

const int tetlinepoints[5]={0,50,100,300,1200} //points for no of lines cleared
//50x2 = 100, 100x3 = 300, 300x4 = 1200
uint8_t tetboard [tetrows][tetcolumns]; //teris board 
int tettype,tetrotation, tetx, tety; //typa piece falling, rotation,row,column
int tetnext; //stores next piece
int tetRandomPiece(){
  return random(7);} //random from 1-7
uint32_t tetrisscore; //currentscore
int tetlines,tetlevel; //no of lines cleared, level
tetlevel = tetlines/10; //increases with lines cleared
uint32_t tetnextdrop =0;
uint32_t tetrepeatat =0; //time for next drop
uint32_t tetnextlim=0; //how often holding down moves piece
int tetlastdir = 0; //left or tight or 0
bool tetfits(int type,int rot, int x, int y){ //if piece in position does it collide
  uint16_t shape = tetshapes[type][rot]; //type and rootation from tet shapes
  for (int i=0;i<16;i++){ //all positions on grid 4x4
    if (shape & (0x8000>>i)){ //position i is occupied
      int col = x+i%4; //column in shape
      int row = y+i/4; //row in shape
      if (col<0 or col>= tetcolumns or row>= tetrows){
        return false;} //left,right or below board, returns false
      if(row>= 0 &&tetboard[row][col]!= 0){
        return false;}}}// if NOTHER BLOCK IN POSITUIKN, square not empty
  return true;} //if both are okay retruns true
void tetdrawcell(int col, int row, int colorindex){ //0=empty,1-7 color
  int x = tetstarthoriz + col*tetcell;
  int y = tetstartvert + row *tetcell; //grid cells to pixels
  if (colorindex ==0){
     tft.fillRect(x,y,tetcell,tetcell,purple); // draws bg color if no piece
     tft.drawRect(x,y,tetcell,tetcell,Lessdark_purple);} //draws outlines for the cells
  else{tft.fillRect(x,y,tetcell,tetcell,Lessdark_purple);
     tft.fillRect(x+1,y+1,tetcell-2,tetcell-2,tet_colors[colorindex-1]);}}
     //draws bg/outlines, has rectangles in color inside
void tetdrawboard(){//draws board
  for(int r=0;r< tetrows;r++){
    for(int c = 0;c< tetcolumns;c++)
  tetdrawcell(c,r,tetboard[r][c]);}}
//nested loops goes through each row, then each column in row
void tetdrawpiece(int type, int rot, int x, int y, int colorindex){
  uint16_t shape = tetshapes[type][rot];
  for (int i = 0;i <16;i++){ //gets shape 4x4
    if (shape & (0x8000>>i)){ //position can have block
      int col = x +(i%4);//column in shape
      int row = y+(i/4);//rowww in shape
      if (row >=0) tetdrawcell(col,row,colorindex);}}} //draws piece at position
      //row zero onwards only tho
void tetdrawnext(){
  tft.FillRect(tetpanelx,184,32,32,purple);
  //draws a 32 pixel bg in purpleee (theme)
  uint16_t shape = tetshapes[tetnext][0];//shape of next shape
  for(int i=0;i=16;i++){//loops through 4x4
    if(shape & (0x8000 >>i)){ //checks if there block
      tft.fillRect(tetpanelx+(i%4)*8,184+(i/4)*8,7,7,tet_colors[tetnext]);}}}
      //horizontal and vertical positions, width,height and color
void tetdrawvalues(){
  char text[16];
  snprintf(text,sizeof(text),"%-6lu",(unsigned long)tetrisscore);
  drawTextBg(tetpanelx,47,text,2,color_text,purple);//current score
  snprint(text,sizeof(text),"%-6lu",(unsigned long)save.highscore[TETRIS]);
  drawTextBg(tetpanelx, 81, text,2,color_text,purple);//high score
  snprint(text,sizeof(text),"%-6d",tetlines); //no of cleared lines
  drawTextBg(tetpanelx,115,text,2,color_text,purple);
  snprint(text,sizeof(text), "%-6d",tetlevel+1); 
  drawTextBg(tetpanelx,149,text,2,color_text,purple);}//level 
void tetrisredraw(){
  tft.fillScreen(purple); //fills screen in bg color,plain
  tft.drawRect(tetstarthoriz-2,tetstartvert-2, tetcolumns*tetcell+4,
               tet_rows*tetcell+4,tetris_accent);//border around board
   draw_text_at(tetpanelx,10,"TETRIS",2,tetris_accent) //title tertis
   draw_text_at(tetpanelx, 36, "SCORE", 1, subtext); //score
   draw_text_at(tetpanelx, 70, "BEST", 1, subtext);//best
   draw_text_at(tetpanelx, 104, "LINES", 1, subtext);//lines cleared
   draw_text_at(tetpanelx, 138, "LEVEL", 1, subtext);//level
   draw_text_at(tetpanelx, 172, "NEXT", 1, subtext);//next block
   tetdrawvalues(); //displays values
   tetdrawboard(); //draws all squares on boardf
   if(tettype >=0){
    tetdrawpiece(tettype,tetrotation,tetx,tety,tettype+1);} //if there piece draw
  tetdrawnext();} //draws next piece preview
bool tettrymove(int dx, int dy, int turn){ //triess to move or rotate
  int newRot =(tetrotation+turn+4)%4; //calculates new rotation bw 0,3
  if(!tetfits(tettype,newRot,tetX+dx,tetY+dy))
  {return false;}//position doesn't fit false
  tetdrawpiece(tettype,tetrot,tetx,tety,0); //erases old position
  tetrotation=newRot;
  tetX += dx;
  tetY += dy;
  tetdrawpiece(tettype,tetrotation,tetx,tety,+1)//draws new position
  return true;}
void tettryrotate() {//tries nearby position if near wall as turning near wall
  //no work
    const int kicks[5] = {0,-1,2,-2,2};//normal position, one square left,two right,
    //two lefty, two rightyyy
    for(int k=0;k <5;k++){
      if(tettrymove(kicks[k],0,1)){return;}}}
      //for all of kicks,tries if move possible,if yes returns
bool tetspawn(){
  tettype = tetnext; //old next piece is new current piece
  tetNext =tetRandomPiece(); //picks new new piecee
  tetrotation =0;
  tetx=3;
  tety=0;//resets default positions of new piece
  tetdrawnext();//updates new on top of csrren
  if (!tetfits(tettype,tetrotation,tetx,tety)){
    return false;}//does not fit,ends game
  tetdrawpiece(tettype,tetrotation,tetx,tety,tettype+1);
   return true;} //draws a new piece, if it fits,true= it fits
int tetdropinterval(){
  int ms= 700-tetlevel*60 //faster every level,starts at 700 ms delay,decreases
  if(ms <100)ms =100;
  return ms;} //returns how quickly piece falls
int tetclearlines(){ //removes full row returns no of full rows
  int rowscleared = 0; //variablefor rows cleared
  for (int r =tetrows-1;r>=0;r--){ //19 to up 
    bool full = true; //assume its full
    for (int c =0;c<tftcolumns;c++){
      if(tetboard[r][c]==0){
        full =false;break;}} //if any row tomt break
    if (full){
      for(int rr = r;rr>0;rr--){ //above falls a row
        for(int c = 0;c<tetcolumns;c++){
          tetboard[rr][c]=tetboard [rr-1][c];}}
        for(int c = 0;c<tetcolumns;c++9){
          tetboard[0][c]=0;} //clears top row because its alr been copied to row down
         cleared++; //rows cleared increases
         r++; //checks row again, if its moved new row must be checked,loop moves
  return cleared;}
bool tetfreezeandnew(){
  uint16_t shape=tetshapes[tettype][tetRot]; //gets shape
  for(int i= 0; i< 16;i++){
    if (shape &(0x8000>>i)){ //checks all positions again
      int col =tetx+i%4;
      int row = tety+i/4; //calculates where it belongs
      if (row>=0)tetboard[row][col]= tetType+1;}} //piece on tet boRD
    int cleared =tetclearlines(); //checks if new piece completes rows/columns
    if(cleared >0){//if cleared awards points
      tetrisscore += tetlinepoints[cleared]*(tetlevel+1); //calculates acc no of
      // rows cleared and level adds to score
      tetlines += cleared; //lines cleared
      tetlevel = tetlines/10; //10 lines = lvel +1
      tetdrawboard(); //draws board again
      sfxyay();}
    return tetspawn();}

void tetrisstart(){
  gameWon=false;
  for (int r = 0; r<tetrows;r++){
    for(int c=0;c<tetcolums;c++){
      tetboard[r][c]=0;}} //nested loop, loops through all rows, all columns 
      //in a row, sets them to 0(clear)
  tetrisscore =0;
  tetlines =0;
  tetlevel=0;
  tetlastdir=0;
  tettype = -1; //aka no value yet
  tetnext = tetRandomPiece();
  tetrisredraw();
  tetspawn(); //draws screen, then first piece
  tetnextdrop = millis() +700; //current time and then 700ms
  tetrepeatat = 0;
  tettetnextlim = 0;
booltetrisupdate(){
    uint32_t now = millis();
    int dir = 0; //no horizontal directions yer
    if(held(Button_left)){dir =-1} //left button is held, direction -1,left
    if(held(Button_right)){dir =1} //right button hel,direction 1,right
    if (dir ==0){tetlastdir=0;} //resets directionf memmory
    else if (dir != tetlastdir){
      tetlastdir=dir;tettrymove(dir,0,0);tetrepeatat = now +180;} //moves once
      //waits 180 ms
    else if ((int32_t)(now-tetrepeatat)>=0){
      tettrymove(dir,0,0);
      tetrepeatat=now+60;} //after first 180,it moves every 60 ms
    if(pressed(Button_up)){tettryrotate();}//tries to rottate piece if up button
    if (pressed(Button_A)){int cells =0;}//A allows for hard drp,locks
    if((int32_t)(now-tetnextdrop)>=0){ //if its time for next drop
      tetnextdrop = now + tetdropinterval();//schedules next drop
      if(!tettrymove(0,1,0)){ //if not true,no moved down 
        return tetfreezeandnew();}}//locked and new one spawns
  return true;}}
//end of tetris
//__________________________________________________________________________
//console menu and display setup
void gamestart (GAMESSSSS game){  //starts selected games
  if (game ==SNAKE){snakeStart();}
  else if (game ==TETRIS){tetrisstart();}
  else if (game == PONG){pongstart();}
  else ##TODO}
bool gameupdate(GAMESSSSS game){
  if (game == SNAKE){return snakeUpdate();}
  else if (game ==TETRIS){return tetrisupdate();}
  else if(game == PONG){return pongupdate();}
  //else TO DO
return false;} // checks the status of each game, returns true if its still going
//false if none of the four options are or the game ends
void gameredraw(GAMESSSSS game){
  if (game==SNAKE){snakeredraw();}
  else if (game ==TETRIS){tetrisredraw();}
  else if(game == PONG){pongRedraw();}
  //else TO DO
} //draws whole screen again, if paused

uint32_t gamescore(GAMESSSSS game){
  if (game ==SNAKE){return snakescore;}
  else if (game == TETRIS){return tetrisscore;}
  else if(game== PONG){return pongplayerscore;}
  return 0;} //returns score in a game

Screen screen = screen_menu;
bool newscreen =true; //new screen, true first time it runs
GAMESSSSS currentgame; //remembers which game the player has selected
uint32_t lastscore =0;
bool lastbestornay =false;
bool paused = false;

struct gameinfo{
  const char*name;uint16_t color;const char *desc[4];const char*controls[2];}
  //contains info about each game, name, color, decriptions and buttons for info scren
const gameinfo GAMESSSSS[GAME_COUNT]={
  {"SNAKE",snake_accent,{"Eat apples (do snakes even eat apples?)",
    "Grow biggerrr","Don't hit yourself", "nom nom nom awayyy :)"},{"move->arrows",
    "select->pause"}}
  {"TETRIS",tetris_accent,{"Blocks spawn ;)","Rotate and stack the blocks.",
  "Clear the lines","No space and you loose."},{"move->left,right",
    "turn->up,A-> drop",}}
  {"PONG",pong_accent,{"Ball go brr","bonk bonk the ball","Hit the ball",
  "Try not to miss"}{"move->up,down","select->pause"}}};
//TO DO RUNNER
const int menuiconwidth = 92;
const int menuiconlength = 92;
int iconslected = 0;
int menubatterywhown =-1;
int menumuteshown = -1;
const uint18_t snakeicon[40*40]={
  0x282C, 0x282C, 0x282C, 0x282C, 0x282C, 0x282C, 0x282C, 0x282C, 0x282C, 0x282C, 0x282C, 0x282C,
  0x282C, 0x282C, 0x282C, 0x282C, 0x282C, 0x282C, 0x282C, 0x282C, 0x282C, 0x282C, 0x282C, 0x282C,
  0x282C, 0x282C, 0x282C, 0x282C, 0x282C, 0x282C, 0x282C, 0x282C, 0x282C, 0x282C, 0x282C, 0x282C,
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  0x282C, 0x282C, 0x282C, 0x282C
};
const uint16_t tetrisicon[40*40]{
    0x4276, 0x4276, 0x4276, 0x4276, 0x4276, 0x4276, 0x4276, 0x4276, 0x4276, 0x4276, 0x4276, 0x4276,
  0x4276, 0x4276, 0x4276, 0x49D2, 0x510D, 0x510D, 0x510D, 0x510D, 0x510D, 0x510D, 0x510D, 0x510D,
  0x49D2, 0x4276, 0x4276, 0x4276, 0x4276, 0x4276, 0x4276, 0x4276, 0x4276, 0x4276, 0x4276, 0x4276,
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  0x4276, 0x4276, 0x4276, 0x4276
};
const uint16_t pongicon[40*40]={
  0xD477, 0xD477, 0xD477, 0xD477, 0xD477, 0xD477, 0xD477, 0xD477, 0xD477, 0xD477, 0xD477, 0xD477,
  0xD477, 0xD477, 0xD477, 0x9B54, 0x394E, 0x394E, 0x394E, 0x394E, 0x394E, 0x394E, 0x394E, 0x394E,
  0x9B54, 0xD477, 0xD477, 0xD477, 0xD477, 0xD477, 0xD477, 0xD477, 0xD477, 0xD477, 0xD477, 0xD477,
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  0xD477, 0xD477, 0xD477, 0xD477
};

const int iconswidth = 40;
const int iconsheight = 40;

void drawgameicon(const uint16_t*imagedata, int width, int height, int centX,
  int centY){
  int imagex = centX - width/2;
  int imagey = centY - height /2; //where img starts from,left and top
  tft.drawRGBBitmap(imageX,imageY,imageData,width,height);}
void drawiconoutline(int i, bool selected){
  int col =i%2; //calculates col
  int row =i/2 //calculates row 
  int x = 8+col*116 //how far from left edge
  int y = 28+row*100//how far from top
  uint color1 = GAMESSSSS[i].color();
  tft.fillRect(x-4,y-4,menuiconwidth+8,menuiconlength+8,purple);
  //clears the space by drawing rectangle in bg color
  tft.fillRoundRect(x,y,menuiconwidth,menuiconlength,6,Lessdark_purple);
  //draws tile background, area around tile 
  uint 16_t bordercolor;
  if(selected==true){bordercolor =accent;}
  else{bordercolor = dimcolor(accent);} //selects color acc gamee
  //it glowy if selected
  tft.drawRoundrect(x,y,menuiconwidth,menuiconlength,6,bordercolor);
  //draws main border (either bright or dim)
  if (selected ==true){tft.drawRoundRect(x-3,y-3,menuiconwidth+6,
  menuiconlength+6,9,accent);
  tft.drawRoundRect(x-2,y-2,menuiconwidth+4,menuiconlength+4,8,accent);}
  //draws extra glowy borders on top of main border
  int iconcenterx = x+menuiconwidth/2;
  int iconcenty = y+32; // icon position,center x and y
  if(i==SNAKE){
    drawgameicon(snakeicon,iconswidth,iconsheight,iconcenterx,iconcenty);}
  else if (i==TETRIS){
    drawgameicon(tetrisicon,iconswidth,iconsheight,iconcenterx,iconcenty);}
  else if (i==PONG){
    drawgameicon(pongicon,iconswidth,iconsheight,iconcenterx,iconcenty);}
  //TO DO RUN 
  draw_text_center(cx,y+menuiconlength-30,GAMESSSSS[I].name,2,accent);
  //prints name of gamee
  char best[20]; //20 character array holds high score
  snprintf(best,sizeof(best),"BEST%lu",(unsigned long)save.highscore[i]);
  //converts nos to text,prints high score in game
  draw_text_center(cx,y+menuiconlength-11,best,1,color_text)
}
void menudrawbattery(){
  drawBatteryicon(Screen_Width-32,8,batteryPercent,batteryPresent);
  menubatterywhown = batteryPercent} //draws battery icon
void drawMuteIcon (int x, int y, bool muted){
  tft.fillRect(x-1,y-1,20,14, purple);
  if (muted == true){
    tft.drawRGBBitmap(x,y,muteIcon, 18, 12);} //draws mute icon
  else{tft.drawRGBitmap(x,y,soundIcon, 18, 12);}} //draws unmute icon if unmuted
void menudrawsound(){
  drawMuteIcon(Screen_Width-56,8, soundmuted);
  if(soundmuted ==true){
    menumuteshown =1;}
  else{menumuteshown =0;}} //draws mute/unmute icons, changes accordingly
void menudrawfinal(){
  if(newscreen=true){
    newscreen = false;
    tft.fillScreen(purple);//clears everything
    draw_text_at(8,6,"GAMES",2,color_text); //heading games at top
    menudrawbattery(); //battery icon
    menudrawsound(); //mute/unmute icons
    for (int i =0;i< GAME_COUNT;I++){
      drawiconoutline(i,i==menuselected);}//repreats for all games, 4 icons
    draw_text_center(Screen_Width/2,229, "A-> CHOOSE | X->mute | SELECT->
      SETTINGS",Lessdark_purple);}} //shows button instructions at bottom
  int old =menuselected;
  int col = menuselected%2;
  int row = menuselected/2;//selcetd tile 0,0;1,0;0,1;1,1
  if(pressed(Button_left)&&col ==1){
    menuselected -=1;}//one starts at left so it does nun
  if(pressed(Button_right)&&col==0){
    menuselected +=1;} //1 to go to tile 1 (to right)
  if(pressed(Button_up)&&row ==1){
    menuselected -=2;}//starts up so ya do nun
  if(pressed(Button_down)&&row ==0){
    menuselected +=2;} //2 to go to til 2(down)
  if(menuselected != old){
    drawiconoutline(old,false) //draws icon of selcted again
    drawiconoutline(menuselected,true);}
    sfxtick(); //plays sound
  if (pressed(Button_A)){
    currentgame =(GAMESSSSS)menuselected; //if A pressed then game is selcted
    sfxtick();
    changescreen(screen_infor); //shows game info screen
    return;}
  if (batteryPercent!= menubatterywhown){menudrawbattery()}//updates battery
  if((soundmuted != menumuteshown)){menudrawsound();}} //updates sound
void infoscreen(){
  const gameinfo& game =GAMES[currentgame];
  if (newscreen ==true){
    newscreen == false; //drawn on it not fresh
    tft.fillScreen(purple);//clears bg
    tft.drawRoundRect(2,2,Screen_Width-4,Screen_Height-4,10,game.color);
    tft.drawRoundRect(3,3,Screen_Width-6,Screen_Height-6,9,game.color);
    //draws on both sides
    draw_text_center(Screen_Width/2,14,game.name,4,game.color)
    //writes game name in games color on info screen
    tft.drawFastHLine(20,52,Screen_Width-40,game.color);
    for (int i=0;i<4;i++){
      draw_text_center(Screen_Width/2,58+i*20,game.desc[i],2,Lessdark_purple);}
    //draws each description line
    draw_text_center(Screen_Width/2,140,"CONTROLS",2,g.color);
    for(int i=0;i<2;i++){
      draw_text_center(Screen_Width/2,164+i*22,game.controls[i],2,Lessdark_purple);}
    //draws controls info
    drawTextCentered(Screen_Width/2, 206,"A-> START", 2, game.color);
    drawTextCentered(Screen_Width / 2, 226, "BACK-> menu", 1, Lessdark_purple)
    ;} //explains start back buttons
    if (pressed(BTN_A)) { sfxTick(); changeScreen(screen_countdown);}
    //if start stars
    if (pressed(BTN_BACK)) { changeScreen(screen_menu);}} //if back menu
void countdown(){
  if(newscreen ==true){
    newscreen =false;
    tft.fillScreen(purple);//erases screen
    draw_text_center(Screen_Width/2,16,"GET READY!!",2,Lessdark_purple);
    draw_text_center(Screen_Width/2,70,"3",12,GAMESSSSS[currentgame].color);
    delay(1000);
    draw_text_center(Screen_Width/2,70,"2",12,GAMESSSSS[currentgame].color);
    delay(1000);
    draw_text_center(Screen_Width/2,70,"1",12,GAMESSSSS[currentgame].color);
    delay(1000);
    draw_text_center(Screen_Width/2, 84,"GO!",8,GAMESSSSS[currentgame].color);
    delay(50);
    paused = false; //plays 3,2,1,go,avoids immediately bobarding player with game
    gameStart(currentGame); //starts said game
    changeScreen(screen_playing);}} //changes screen
void drawpausebox(){
  uint16_t color = GAMESSSSS[currentgame].color;
  tft.fillRoundRect(40,84,160,76,8,Lessdark_purple);
  tft.drawRoundRect(40,84,160,76,8,color);
  draw_text_center(Screen_Width/2,94,"PAUSED",3,color);
  draw_text_center(Screen_Width/2,128,"select->resume",1,color_text);
  draw_text_center(Screen_Width/2,142,"back->quit",1,subtext);}
void playing(){ //stuff that happens when wel ya guessed it playing
  if(newscreen){
    newscreen=false;} //game drew
  if(pressed(Button_Select)){
    paused =!paused;//changes pause state to opp
    if (paused==true){drawpausebox();}
    else{gameredraw(currentgame);}} //if paused upauses and draws game again,
    //if unpaused it pause
    if(pressed(Button_Back)){
      paused =false; //game not paused,it closed
      changescreen(screen_menu);
      return;} //if back returns to menu
    if(paused ==true){
      return;} //stops
    bool running=gameupdate(currentgame); //update,current game check if running
    if (runing ==false){lastscore = gamescore(currentgame)}
    //if game no runnning aka ended last score is current game's score
    lastbestornay =false; //assumes false
    if(lastscore > save.highscore[currentgame]){
      save.highscore[currentgame] =lastscore} //updates saved high score
    lastbestornay=true; //last was best
    saveWrite();} //saves changes
    if (gameWon==true){sfxyay();}
    else{sfxwomp();}
    changescreen(screen_menu);}}
void gameover(){
  const gameinfo & game =GAMESSSSS[currentgame];
  if (newscreen==true){
    newscreen==false;} //no longer new unused
    tft.fillScreen(purple); //clears screen
    tft.drawRoundRect(2,2,Screen_Width-4,Screen_Height-4,10,game.color);
    //draws an outer border
    if(gameWon ==true){
      draw_text_center(Screen_Width/2,"YOU WINN!!✧⁠\⁠(⁠>⁠o⁠<⁠)⁠ﾉ⁠✧✧⁠\⁠(⁠>⁠o⁠<⁠)⁠ﾉ⁠✧",4,
        game.color);}
      //if player wins you won
    else{draw_text_center(Screen_Width/2,"Game over∼∼",4,game.color);}
    //game over if no win (no lose cuz some games can't lose)
    char text[24];
    snprintf(text,sizeof(text),"Score:%lu,(unsigned long)lastscore");
    //makes string prints last score
    draw_text_center(Screen_Width/2,126,text,2,Lessdark_purple);
    //shows high score
    if(lastbestornay=true){
      draw_text_center(Screen_Width/2,158,"NEW BEST✧⁠\⁠(⁠>⁠o⁠<⁠)⁠ﾉ⁠✧✧⁠\⁠(⁠>⁠o⁠<⁠)⁠ﾉ⁠✧",3,
      yellow);
    draw_text_center(Screen_Width/2,200,"A->play again",2,game.color);
    draw_text_center(Screen_Width/2,224,"BACK->exit game",1,Lessdark_purple);}
  // IF A button was pressed.
  if (pressed(Button_A)) {
    sfxTick(); //plays sound
    changeScreen(screen_countdown);} //countdown the game again
  // IF back button was pressed.
  if (pressed(Button_Back)) {changescreen(screen_menu);}} //back to menu
int settingsog = 0;
void settingsdrawrow(int row){
  int y = 70+row*50; //calculates vertical position
  tft.fillRect(8,-4,Screen_Width,-16,40,purple); //clears row space
  if (row == settingsog){
    tft.drawRoundRect(8,y,-4,Screen_Width-16,40,6,WHITE);}
    //highlights selcted row
  if(row ==0){draw_text_at(18,y+8,"Brightness",2,color_text)} //writes brightness
  //first row
  else if(row==1){
    draw_text_at(18,y+8,"Music",2,color_text);} //writes music,row2
  else{draw_text_at(18,y+8,"Beeps",2,color_text);}
  if (row==0){
    for(int i=0;i<5;i++){ //draws brightness bars
      uint16_t color = Lessdark_purple;
      if(i<save.brightness){color = color_text;}
      tft.fillRect(150+i*14,y+6,10,20,color);}
  else{bool settingon=false; 
        if(row==1){setting on =save.musicon;}
        else{settingon =save,sfxOn} //check music and beeps
        if(settingon ==true){draw_text_at(170,y+8,"ON",2,green);}
        else{draw_text_at(170,y+8,"OFF",2,RED);}}}} //On or off
void settingscontinue(){
  if (newscreen==true){
    newscreen= false;
    tft.fillScreen(purple);
    draw_text_center(Screen_Width/2,16,"settings",3,color_text);
    for (int i=0;i<3;i++){settingsdrawrow(i);} //draws all 3 settings in loop,one by one
    draw_text_center(Screen_Width/2,214,"up/Down->pick left/right->change",1,
      Lessdark_purple);
    draw_text_center(Screen_Width/2,228,"Back-> save and exit",1,
      Lessdark_purple);} //draws rows, then adds instruct text
  int oldrow = settingsog; //remembers previos row
  if (pressed(Button_up)&& settingsog > 0){settingsog--;}
  //moves up from previously selcted row after checking its not row 1 alr
  if (prssed(Button_down)&& settingsog<2){settingsog++;}
  //moves down after checking its not og
  if (oldrow !=settingsog){
    settingsdrawrow(oldrow);
    settingsdrawrow(settingsog);} //redrwas rows if diff section
  if (pressed)(Button_left) or (pressed)(Button_right){
    //if user tryna update stuff
    if(settingsog ==0){ //if on brightness
      if (pressed(Button_left) && save.brightness>1){save.brightness--;}
      //if left and its nit on min reduce it
      if(pressed(Button_right)&& save.brightness <5){save.brightness++1;}
      //if its right and not on max increasee
      backlightset(save.brightness)} //updates the change
  else if (settingsog ==1){// if music setting
    save.musicon = !save.musicon; //swaps music settings, on if off of if on
    musicapply();} //changes music settings
  else{save.sfxon = !save.sfxon
        sfxgood();} //if not music its for sound effecrs
  settingsdrawrow(settingsog);} //redraws accting for change
  if (pressed(Button_back)){ //if back button prssed saves changes, exits settings
    saveWrite();
    changescreen(screen_menu);}} //shows menu again
void setup(){ //first when it on
  Serial.begin(115200); //allws messges 
  storagebegin(); //finds high score and settings
  display_begin(); //starts screen
  tft.fillScreen(purple); //clears background
  draw_text_center(Screen_Width/2,100,"STARTING..",2,color_text);
  backlightset(save.brightness); //updates backlight brightness
  inputBegin(); //starts input setting
  batteryread(); //checks battery
  soundbegin(); //checks audio devices then plays
  randomSeed(micros()^
  ((uint32_t)analogread(BATTERY_PIN)<<8));
  serial.println("Console ready");
  changescreen(screen_menu);}
void loop(){//loop afterwards
  inputupdate(); //read buttons
  soundUpdate(); //mute or unmute
  batteryUpdate(); //measures battery every few secs
  switch(screen){ //depending on iput or which screen runs function accordingly
    case screen_menu: menudrawfinal();
    break;
    case screen_infor: infoscreen();
    break;
    case screen_countdown:countdown();
    break;
    case screen_playing: playing();
    break;
    case screen_gameover: gameover();
    break;
    case screen_settings; settingscontinue();
    break;}}
//THE ENDDDDDD YAYYY








    






  
  
    


      










  
    













  











 





  




















    











  






  


























